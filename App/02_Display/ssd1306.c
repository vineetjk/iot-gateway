/**
 * ssd1306.c
 * =========================================================================
 * SSD1306 0.91" 128x32 OLED driver implementation.
 * =========================================================================
 */
#include "ssd1306.h"
#include <string.h>

/* 6×8 font data (ASCII 0x20–0x7E) */
static const uint8_t font6x8[][6] = {
    {0x00,0x00,0x00,0x00,0x00,0x00},{0x00,0x00,0x5F,0x00,0x00,0x00},
    {0x00,0x07,0x00,0x07,0x00,0x00},{0x14,0x7F,0x14,0x7F,0x14,0x00},
    {0x24,0x2A,0x7F,0x2A,0x12,0x00},{0x23,0x13,0x08,0x64,0x62,0x00},
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    {0x10,0x08,0x08,0x10,0x08,0x00},
};

FontDef Font_6x8  = {6, 8, (const uint8_t *)font6x8};
FontDef Font_7x10 = {6, 8, (const uint8_t *)font6x8};  /* alias */

static uint8_t            fb[SSD1306_W * SSD1306_H / 8];
static uint8_t            cx = 0, cy = 0;
static I2C_HandleTypeDef *hi2c_g;

static void cmd(uint8_t c)
{ uint8_t b[2]={0x00,c}; HAL_I2C_Master_Transmit(hi2c_g,SSD1306_ADDR,b,2,HAL_MAX_DELAY); }

static const uint8_t init_seq[] = {
    0xAE,0xD5,0x80,0xA8,0x1F,0xD3,0x00,0x40,
    0x8D,0x14,0x20,0x00,0xA1,0xC8,0xDA,0x02,
    0x81,0xCF,0xD9,0xF1,0xDB,0x40,0xA4,0xA6,0xAF
};

void SSD1306_Init(I2C_HandleTypeDef *h)
{
    hi2c_g = h;
    HAL_Delay(50);
    for (uint8_t i = 0; i < sizeof(init_seq); i++) cmd(init_seq[i]);
    SSD1306_Clear();
    SSD1306_UpdateScreen();
}

void SSD1306_Clear(void)          { memset(fb, 0, sizeof(fb)); }
void SSD1306_SetCursor(uint8_t x, uint8_t y) { cx=x; cy=y; }

void SSD1306_DrawPixel(uint8_t x, uint8_t y, SSD1306_Color col)
{
    if (x>=SSD1306_W||y>=SSD1306_H) return;
    if (col==White) fb[x+(y/8)*SSD1306_W] |=  (1<<(y%8));
    else            fb[x+(y/8)*SSD1306_W] &= ~(1<<(y%8));
}

static void write_char(char ch, FontDef f, SSD1306_Color col)
{
    if (ch<0x20||ch>0x7E) ch='?';
    const uint8_t *g = f.data + (ch-0x20)*f.w;
    for (uint8_t c=0;c<f.w;c++) {
        uint8_t ln=g[c];
        for (uint8_t r=0;r<f.h;r++)
            SSD1306_DrawPixel(cx+c,cy+r,(ln&(1<<r))?col:(SSD1306_Color)!col);
    }
    cx += f.w;
}

void SSD1306_WriteString(const char *s, FontDef f, SSD1306_Color col)
{ while (*s) write_char(*s++, f, col); }

/* Write string at signed x position (allows negative for scroll clipping) */
void SSD1306_WriteStringAt(int16_t x, uint8_t y, const char *s,
                            FontDef f, SSD1306_Color col)
{
    while (*s) {
        char ch = *s++;
        if (ch < 0x20 || ch > 0x7E) ch = '?';
        if (x + (int16_t)f.w > 0 && x < SSD1306_W) {
            /* At least partially visible */
            const uint8_t *g = f.data + (ch - 0x20) * f.w;
            for (uint8_t c = 0; c < f.w; c++) {
                int16_t px = x + c;
                if (px < 0 || px >= SSD1306_W) continue;
                uint8_t ln = g[c];
                for (uint8_t r = 0; r < f.h; r++)
                    SSD1306_DrawPixel((uint8_t)px, y + r,
                                      (ln & (1 << r)) ? col : (SSD1306_Color)!col);
            }
        }
        x += f.w;
        if (x >= SSD1306_W) break;  /* rest is off-screen right */
    }
}

/* Large numeric font 12x16 — digits 0-9, '.', '-', ' ' (13 glyphs)
 * Each glyph: 12 columns × 16 rows, stored column-major as 12 × 2 bytes */
static const uint8_t font12x16_data[] = {
    /* '0' */ 0x00,0x00, 0xF8,0x07, 0xFC,0x0F, 0x06,0x18, 0x02,0x10, 0x02,0x10, 0x02,0x10, 0x02,0x10, 0x06,0x18, 0xFC,0x0F, 0xF8,0x07, 0x00,0x00,
    /* '1' */ 0x00,0x00, 0x00,0x00, 0x08,0x10, 0x08,0x10, 0x0C,0x10, 0xFE,0x1F, 0xFE,0x1F, 0x00,0x10, 0x00,0x10, 0x00,0x10, 0x00,0x00, 0x00,0x00,
    /* '2' */ 0x00,0x00, 0x18,0x18, 0x1C,0x1C, 0x06,0x1E, 0x02,0x17, 0x82,0x13, 0xC2,0x11, 0xE2,0x10, 0x76,0x10, 0x3C,0x10, 0x18,0x10, 0x00,0x00,
    /* '3' */ 0x00,0x00, 0x08,0x04, 0x0C,0x0C, 0x06,0x18, 0x42,0x10, 0x42,0x10, 0x42,0x10, 0x42,0x10, 0xE6,0x18, 0xBC,0x0F, 0x18,0x07, 0x00,0x00,
    /* '4' */ 0x00,0x00, 0x80,0x03, 0xC0,0x03, 0x60,0x02, 0x30,0x02, 0x18,0x02, 0x0C,0x02, 0x06,0x02, 0xFE,0x1F, 0xFE,0x1F, 0x00,0x02, 0x00,0x00,
    /* '5' */ 0x00,0x00, 0x7E,0x04, 0x7E,0x0C, 0x62,0x18, 0x22,0x10, 0x22,0x10, 0x22,0x10, 0x22,0x10, 0x62,0x18, 0xC2,0x0F, 0x82,0x07, 0x00,0x00,
    /* '6' */ 0x00,0x00, 0xF8,0x07, 0xFC,0x0F, 0x46,0x18, 0x22,0x10, 0x22,0x10, 0x22,0x10, 0x22,0x10, 0x66,0x18, 0xC4,0x0F, 0x84,0x07, 0x00,0x00,
    /* '7' */ 0x00,0x00, 0x02,0x00, 0x02,0x00, 0x02,0x1C, 0x02,0x0F, 0x82,0x03, 0xE2,0x00, 0x72,0x00, 0x1A,0x00, 0x0E,0x00, 0x06,0x00, 0x00,0x00,
    /* '8' */ 0x00,0x00, 0x98,0x07, 0xBC,0x0F, 0xE6,0x18, 0x42,0x10, 0x42,0x10, 0x42,0x10, 0x42,0x10, 0xE6,0x18, 0xBC,0x0F, 0x98,0x07, 0x00,0x00,
    /* '9' */ 0x00,0x00, 0x78,0x04, 0xFC,0x08, 0xC6,0x19, 0x02,0x11, 0x02,0x11, 0x02,0x11, 0x02,0x11, 0xC6,0x18, 0xFC,0x0F, 0x78,0x07, 0x00,0x00,
    /* '.' */ 0x00,0x00, 0x00,0x00, 0x00,0x00, 0x00,0x00, 0x00,0x18, 0x00,0x18, 0x00,0x00, 0x00,0x00, 0x00,0x00, 0x00,0x00, 0x00,0x00, 0x00,0x00,
    /* '-' */ 0x00,0x00, 0x80,0x00, 0x80,0x00, 0x80,0x00, 0x80,0x00, 0x80,0x00, 0x80,0x00, 0x80,0x00, 0x00,0x00, 0x00,0x00, 0x00,0x00, 0x00,0x00,
    /* ' ' */ 0x00,0x00, 0x00,0x00, 0x00,0x00, 0x00,0x00, 0x00,0x00, 0x00,0x00, 0x00,0x00, 0x00,0x00, 0x00,0x00, 0x00,0x00, 0x00,0x00, 0x00,0x00,
};

FontDef Font_12x16 = {12, 16, font12x16_data};

/* Write large-font string (only handles 0-9, '.', '-', ' ') */
static void write_large_char(int16_t x, uint8_t y, char ch, SSD1306_Color col)
{
    uint8_t idx;
    if (ch >= '0' && ch <= '9')      idx = ch - '0';
    else if (ch == '.')              idx = 10;
    else if (ch == '-')              idx = 11;
    else                             idx = 12; /* space */

    const uint8_t *g = font12x16_data + idx * 24; /* 12 cols × 2 bytes */
    for (uint8_t c = 0; c < 12; c++) {
        int16_t px = x + c;
        if (px < 0 || px >= SSD1306_W) continue;
        uint16_t col_data = g[c * 2] | ((uint16_t)g[c * 2 + 1] << 8);
        for (uint8_t r = 0; r < 16; r++) {
            uint8_t py = y + r;
            if (py >= SSD1306_H) break;
            SSD1306_DrawPixel((uint8_t)px, py,
                              (col_data & (1 << r)) ? col : Black);
        }
    }
}

void SSD1306_WriteLargeString(int16_t x, uint8_t y, const char *s, SSD1306_Color col)
{
    while (*s) {
        if (x + 12 > 0 && x < SSD1306_W)
            write_large_char(x, y, *s, col);
        x += 12;
        s++;
        if (x >= SSD1306_W) break;
    }
}

/* Drawing primitives */
void SSD1306_DrawHLine(uint8_t x, uint8_t y, uint8_t w, SSD1306_Color col)
{ for (uint8_t i = 0; i < w; i++) SSD1306_DrawPixel(x + i, y, col); }

void SSD1306_DrawRect(uint8_t x, uint8_t y, uint8_t w, uint8_t h, SSD1306_Color col)
{
    SSD1306_DrawHLine(x, y, w, col);
    SSD1306_DrawHLine(x, y + h - 1, w, col);
    for (uint8_t i = 0; i < h; i++) {
        SSD1306_DrawPixel(x, y + i, col);
        SSD1306_DrawPixel(x + w - 1, y + i, col);
    }
}

void SSD1306_FillRect(uint8_t x, uint8_t y, uint8_t w, uint8_t h, SSD1306_Color col)
{
    for (uint8_t j = 0; j < h; j++)
        for (uint8_t i = 0; i < w; i++)
            SSD1306_DrawPixel(x + i, y + j, col);
}

void SSD1306_InvertScreen(void)
{
    for (uint16_t i = 0; i < sizeof(fb); i++)
        fb[i] = ~fb[i];
}

void SSD1306_DrawBitmap(uint8_t x, uint8_t y, uint8_t w, uint8_t h,
                         const uint8_t *data, SSD1306_Color col)
{
    for (uint8_t j = 0; j < h; j++)
        for (uint8_t i = 0; i < w; i++) {
            uint16_t bit = j * w + i;
            if (data[bit / 8] & (1 << (7 - (bit % 8))))
                SSD1306_DrawPixel(x + i, y + j, col);
        }
}

void SSD1306_UpdateScreen(void)
{
    cmd(0x21); cmd(0); cmd(127);
    cmd(0x22); cmd(0); cmd(3);
    uint8_t *p = fb;
    for (uint16_t i = 0; i < sizeof(fb); i+=16) {
        uint8_t buf[17]; buf[0]=0x40;
        memcpy(buf+1, p+i, 16);
        HAL_I2C_Master_Transmit(hi2c_g, SSD1306_ADDR, buf, 17, HAL_MAX_DELAY);
    }
}
